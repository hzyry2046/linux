## Documentation/devicetree/bindings/misc/realme,op6893-conn-preflight.yaml
```yaml
# SPDX-License-Identifier: (GPL-2.0-only OR BSD-2-Clause)
%YAML 1.2
---
$id: http://devicetree.org/schemas/misc/realme,op6893-conn-preflight.yaml#
$schema: http://devicetree.org/meta-schemas/core.yaml#

title: Experimental op6893 connectivity preflight observer

maintainers:
  - hzyry2046 <hzyry2046@163.com>

description: |
  Local board bring-up interface, not a connectivity hardware binding.
  Observes audited always-on AP ranges and PMIC registers without powering
  CONN or selecting pins. Supply handles identify real leaf providers only;
  they do not establish managed ownership of upstream inherited inputs.
  An explicit opt-in permits a one-shot RC common-rail cycle with CONN off.
  Shared parent regulators receive votes retained until reboot; their
  voltage, modes and hardware enable bits are not intentionally changed.

properties:
  compatible:
    const: realme,op6893-conn-preflight

  mediatek,pmic-wrapper:
    $ref: /schemas/types.yaml#/definitions/phandle
    description: PMIC wrapper providing the MT6359P serial register map.

  realme,allow-inherited-parent-rail-cycle:
    type: boolean
    description: |
      Allow an explicit root-triggered experiment against the audited
      cold-boot baseline. No cycle executes automatically at probe or boot.

  realme,allow-conn-domain-cycle:
    type: boolean
    description: |
      Additionally permit explicit domain-cycle, using audited legacy power
      sequencing, finite polls and guarded read-only digital identification.
      Also permit csr-cycle, which only samples three on-domain HOST_CSR
      words after checking the AP-to-CONN path and never reads digital ID.
      id-cycle additionally requests a HOST_CSR clock-detector reset and
      checks clock, timeout and sleep status before reading digital ID.
      post-id-cycle also samples audited RGU, SYSRAM control and remap words
      without modifying them, using the imported dynamic CONN reservation.
      remap-cycle saves four MCU/peripheral remaps, tests masked writes from
      that allocation, verifies readback, then restores originals before
      shutdown. Failed restoration retains the domain, pins and supplies.
      rgu-cycle tests four memory hardware power/sleep policy words against
      the audited baseline, with verified reverse restoration and the same
      failure containment. Register restoration does not prove RAM retention.
      spi-baseline samples A-die reset, RF SPI busy, WB status and 36 sleep
      command configuration words after digital identification. It does not
      issue an RF SPI transaction or write any of those sampled registers.
      spi-config-cycle tests 36 masked sleep-command configuration words
      against the observed baseline. Command length is written last and
      restored first. A-die reset/control and SPI/WB status are checked at
      every access; observed loss is latched and retains domain resources.
      This does not release A-die reset or issue an RF SPI transfer.
      sema-cycle requests RF SPI semaphore11 once through its M2 acquire
      read, checks four master reports, releases only an acknowledged and
      consistent grant, and polls the passive M2 report with a deadline.
      Unknown ownership or access loss retains domain resources until reboot.
      sysram-cycle holds the tested RGU memory policy while clearing and
      verifying all 16 KiB of volatile SYSRAM with A-die reset held. Old
      contents are discarded, not restored. Guard loss retains resources;
      successful verification permits RGU restoration and domain shutdown.
      strap-cycle tests GPIO180 output-high under held A-die reset, using
      separate preparation, GPIO mux, peripheral mux, low and input states.
      AP readbacks verify direction/latch/mux and unchanged shared fields;
      uncertain switching or guard loss retains domain/pins/supplies.
      prepare-cycle nests remap, RGU, SPI configuration, SYSRAM clear and
      strap setup before semaphore acquisition/release. A-die reset stays
      asserted. Each outer stage restores only after its children have
      released ownership and verified restoration; uncertainty retains all
      affected outer resources. SYSRAM contents are discarded, not restored.
      adie-id-cycle uses that nested preparation while holding semaphore11,
      releases A-die reset and issues one TOP SPI read of chip ID register
      0x02c. After idle confirmation it reasserts reset and restores the TOP
      address latch before unlocking. Access, ownership, busy timeout or
      reset restoration uncertainty retains all outer resources. No analog
      register writes, firmware download or calibration are performed.
      adie-xtal-cycle additionally reads TOP 0xa18 and 0xa1c after a fresh
      chip ID, with per-transfer busy/data-change evidence. It uses the
      same reset, address restoration and containment rules.
      adie-write-cycle requires the measured E3 ID and XTAL baseline, then
      writes TOP 0xa18 to 0xf6e8fff5, reads it back, restores its saved value
      and verifies restoration after an intervening chip ID read. Uncertain
      analog restoration retains reset, semaphore and all outer resources.
      This bounded transport experiment is not full analog initialization.
      adie-mailbox-cycle requires completed SYSRAM initialization and a fresh
      A-die ID, writes that ID to SYSRAM offset 0x2800, verifies it, clears
      it and verifies zero before reset/unlock. Unexpected initial contents
      or unconfirmed cleanup retain all outer resources. No firmware runs.
      adie-config-read performs two rounds of fixed TOP 0x064 and 0x0bc reads,
      separated by chip ID reads. Each response needs fresh data evidence;
      the two rounds must match. No analog write commands are issued. This
      characterizes read responses, not register rollback or reset semantics.
      adie-config-cycle requires the measured E3 ID and two-round 0/1 config
      baseline, then holds the ID mailbox while applying TOP 0x064=0x7700
      followed by 0x0bc=0x21. Each value is read back. Reverse restoration
      uses ID-separated reads of the original 1/0 values before clearing the
      mailbox and restoring outer resources. Uncertainty retains resources;
      register restoration does not establish reversal of internal analog state.
      adie-route-read holds the same prefix and mailbox while reading two
      rounds of fixed FM_CTRL, thermal address, THERMCR1, THERM_CAL_EN and
      GPT2 thermal-enable words. It does not write these digital registers.
      Thermal semaphore13 ownership, sampled start/enable bits or changed
      baselines retain all resources. Passive ownership reports are not an
      acquired thermal semaphore; stable readings do not prove engine quiescence.
      adie-fm-cycle additionally requires the measured FM/thermal baseline,
      clears FM_CTRL mask 0x80ff, verifies the target, restores the saved word
      and verifies restoration before analog/mailbox cleanup. Thermal words
      and ownership reports are checked throughout. Uncertain FM restoration
      retains all parents. No thermal address or trigger writes are made.
      adie-efuse-ctrl-read holds the FM configuration while reading fixed
      TOP chip-ID/control/chip-ID/control addresses. Each response requires
      independent freshness, and both controls must match with kick clear
      and read mode selected. It neither writes TOP 0x108 nor reads private
      efuse data words. Unexpected engine state retains all resources.
      adie-efuse-cycle requires a fresh stable control baseline with kick,
      valid, mode and address fields zero. It issues one address0/read-mode
      kick, then reads ID-separated control responses until two consecutive
      kick-clear/valid-set observations. A 250 ms diagnostic deadline and
      70-round cap bound the guarded experiment. No private data words or
      calibration writes follow. Uncertain completion retains all parents;
      no speculative kick replay or cancellation is performed.
      adie-efuse-observe uses the same prerequisite and single kick but only
      observes three ID-separated control responses within the same deadline.
      Only stable low-six-bit differences with kick clear and valid set permit
      further observation. It always retains parents and returns an error,
      including after stable observations; no completion/cleanup is authorized.
      Cached diagnostics expose difference masks, not raw control/data words.
      adie-efuse-stable-cycle experimentally permits cleanup after those same
      three stable observations. Only low-six-bit differences are allowed;
      all other nonstatus bits must match the original baseline. This is an
      empirical E3-device rule, not a generic efuse field specification.
      No control restoration, private data reads or thermal trim follow.
      adie-efuse-data-read adds two rounds of fixed TOP 0x130/134/138/13c reads
      after that accepted completion. ID separators and exact control-state
      rechecks surround each word, with independent SPI timeouts and a 2 s
      diagnostic data budget. Raw words stay in temporary buffers and are
      explicitly erased on every exit; only counters and equality are exposed.
      RDAT-derived diagnostics are redacted and erased after outer cleanup.
      Any data uncertainty retains parents. No SYSRAM data handoff, thermal
      trim or firmware start is performed.
      adie-efuse-handoff-cycle additionally maps only the four software-control
      slots at SYSRAM + 0x2804 through + 0x2810. It requires zero baselines,
      writes and verifies the repeated private words, then clears and verifies
      all four slots before any parent cleanup. It shares the 2 s data budget.
      Failures retain parents and conservative dirty metadata; no speculative
      erase is attempted after loss of access guards. Only masks are exposed.
      This diagnostic handoff does not apply thermal trim or start firmware.
      adie-thermal-read follows verified handoff erasure with two rounds of
      fixed TOP 0x034/038 reads, each bracketed by ID and exact control checks.
      The same 2 s budget includes all private reads, handoff and thermal reads.
      Inherited thermal values remain private and are erased on every exit;
      only transport, comparison and erasure metadata are exposed. Any error
      retains parents. No thermal-register write or calibration is performed.
      adie-thermal-plan additionally compares the vendor's inclusive-input
      trim sequence against a width-bounded interpretation in private memory.
      It reports only whether each sequence is a no-op at every step and
      whether the sequences agree at every step. All candidates are erased;
      completion requires a final access/deadline guard. No trim is written.
      adie-pad-read requires a fresh complete plan with both sequences no-op
      and equivalent before reading TOP 0x070 twice. Each read is bracketed
      by ID and exact control checks, under the same 2 s total data budget.
      It exposes only equality to the vendor 0x80000000 target and transport
      metadata. Non-no-op plans or read uncertainty retain parents; values
      are erased on every exit. No pad configuration is written.

  pinctrl-names:
    items:
      - const: conn-active
      - const: conn-idle
      - const: strap-prepare
      - const: strap-high
      - const: strap-mux
      - const: strap-low
      - const: strap-input

  pinctrl-0: true
  pinctrl-1: true
  pinctrl-2: true
  pinctrl-3: true
  pinctrl-4: true
  pinctrl-5: true
  pinctrl-6: true

  vs1-supply:
    description: Shared MT6359P VS1 buck.
  vs2-supply:
    description: Shared MT6359P VS2 buck.
  vcn13-supply:
    description: MT6359P connectivity 1.3 V rail.
  vcn18-supply:
    description: MT6359P connectivity 1.8 V rail.
  vcn33-1-supply:
    description: MT6359P connectivity 3.3 V rail 1.
  vcn33-2-supply:
    description: MT6359P connectivity 3.3 V rail 2.

required:
  - compatible
  - mediatek,pmic-wrapper
  - vs1-supply
  - vs2-supply
  - vcn13-supply
  - vcn18-supply
  - vcn33-1-supply
  - vcn33-2-supply

additionalProperties: false

dependentRequired:
  realme,allow-conn-domain-cycle:
    - realme,allow-inherited-parent-rail-cycle
    - pinctrl-names
    - pinctrl-0
    - pinctrl-1
    - pinctrl-2
    - pinctrl-3
    - pinctrl-4
    - pinctrl-5
    - pinctrl-6
```

## Documentation/devicetree/bindings/misc/realme,op6893-modem-handoff.yaml
```yaml
# SPDX-License-Identifier: (GPL-2.0-only OR BSD-2-Clause)
%YAML 1.2
---
$id: http://devicetree.org/schemas/misc/realme,op6893-modem-handoff.yaml#
$schema: http://devicetree.org/meta-schemas/core.yaml#

title: Realme op6893 LK modem metadata handoff inspection

maintainers:
  - hzyry2046 <hzyry2046@163.com>

description: |
  Board-specific passive inspection of the LK modem handoff. The tags region
  holds the little-endian tag chain described by ccci,modem_info_v2 under
  /chosen. The property is a 48-byte opaque LK structure, not big-endian DT
  cells: u64 address, u32 size, s32 error, s32 version, s32 count, u32 load
  flag, four s32 modem errors and four bytes of native tail padding.
  The board FDT merger validates and imports this property from the current
  LK FDT; it must not be hardcoded in a DTS. Versions 2 and 3 use 76-byte
  tag descriptors with a 64-byte name and three little-endian u32 fields.
  This node does not control modem power, reset, clocks, interrupts or DMA.
  All referenced regions must be static no-map reserved memory. Only the
  bounded tag chain is read; the other regions constrain decoded addresses.

properties:
  compatible:
    const: realme,op6893-modem-handoff

  memory-region:
    items:
      - description: LK tag buffer
      - description: AP and modem noncached shared memory
      - description: AP and modem cached shared memory

  memory-region-names:
    items:
      - const: tags
      - const: noncached
      - const: cached

required:
  - compatible
  - memory-region
  - memory-region-names

additionalProperties: false

examples:
  - |
    modem-handoff {
        compatible = "realme,op6893-modem-handoff";
        memory-region = <&ccci_tag>, <&md_nc_smem>, <&md_c_smem>;
        memory-region-names = "tags", "noncached", "cached";
        status = "disabled";
    };
```
