## Documentation/devicetree/bindings/misc/realme,op6893-modem-platform.yaml
```yaml
# SPDX-License-Identifier: (GPL-2.0-only OR BSD-2-Clause)
%YAML 1.2
---
$id: http://devicetree.org/schemas/misc/realme,op6893-modem-platform.yaml#
$schema: http://devicetree.org/meta-schemas/core.yaml#

title: Realme op6893 cold modem platform owner

maintainers:
  - hzyry2046 <hzyry2046@163.com>

description: |
  Board-specific owner of the LK 6297 shared-memory layout and MD power
  prerequisites. Uses the same LK metadata contract as modem-handoff, which
  must not be enabled alongside this node. The four supplies must already
  be enabled with stable voltages from this boot's LK handoff. Only one cold
  power cycle is supported, without voltage changes or MD CPU release.
  An inherited ON domain is held until an explicit LK completion check and
  power-off request; probe and unused-domain work must preserve its state.
  The power-domain lives in a lookup-only child to prevent platform-bus
  attachment from powering MD1 before the platform sequence has run.
  Optional ordinary AP/MD CCIF windows and data/exception IRQs allow the
  same owner to prepare SRAM and the validated 6297 shared-memory rings.
  Optional CCIF2 windows and inherited clock references belong to this same
  owner. The SCP phandle leases the separate boot-lifetime SCP runtime; it
  neither starts SCP nor establishes modem readiness at probe.

properties:
  compatible:
    const: realme,op6893-modem-platform

  reg:
    minItems: 2
    items:
      - description: Ordinary AP CCIF window
      - description: Ordinary MD CCIF window
      - description: SCP bridge AP CCIF2 window
      - description: SCP bridge MD CCIF2 window

  reg-names:
    minItems: 2
    items:
      - const: ccif-ap
      - const: ccif-md
      - const: ccif2-ap
      - const: ccif2-md

  interrupts:
    items:
      - description: CCIF data notification
      - description: CCIF exception notification

  interrupt-names:
    items:
      - const: data
      - const: exception

  memory-region:
    items:
      - description: LK tag buffer, static no-map reserved memory
      - description: AP and modem noncached shared memory, static no-map
      - description: AP and modem cached shared memory, static no-map

  memory-region-names:
    items:
      - const: tags
      - const: noncached
      - const: cached

  md-vmodem-supply:
    description: SID3 VBUCK1 VMODEM
  md-vnr-supply:
    description: SID3 VBUCK3 VNR
  md-vsram-supply:
    description: SID3 VBUCK4 VSRAM_MD
  md-vdigrf-supply:
    description: MT6359P VPU VRFDIG

  clocks:
    minItems: 4
    maxItems: 6
  clock-names:
    minItems: 4
    items:
      - const: ccif-ap
      - const: ccif-md
      - const: ccif1-ap
      - const: ccif1-md
      - const: ccif2-ap
      - const: ccif2-md

  mediatek,scp:
    $ref: /schemas/types.yaml#/definitions/phandle
    description: Unique op6893 SCP runtime provider for a generation-scoped lease

  mediatek,spm:
    $ref: /schemas/types.yaml#/definitions/phandle
    description: SPM syscon for resource request and domain readback
  mediatek,infracfg:
    $ref: /schemas/types.yaml#/definitions/phandle
    description: Infracfg AO syscon for MD source clocks and protection readback

  power:
    type: object
    additionalProperties: false
    properties:
      power-domains:
        maxItems: 1
    required:
      - power-domains

required:
  - compatible
  - memory-region
  - memory-region-names
  - md-vmodem-supply
  - md-vnr-supply
  - md-vsram-supply
  - md-vdigrf-supply
  - clocks
  - clock-names
  - mediatek,spm
  - mediatek,infracfg
  - power

additionalProperties: false

dependencies:
  reg: [reg-names, interrupts, interrupt-names]
  reg-names: [reg, interrupts, interrupt-names]
  interrupts: [reg, reg-names, interrupt-names]
  interrupt-names: [reg, reg-names, interrupts]

allOf:
  - if:
      required: ["mediatek,scp"]
    then:
      required: [reg, reg-names]
      properties:
        reg:
          minItems: 4
        reg-names:
          minItems: 4
        clocks:
          minItems: 6
        clock-names:
          minItems: 6
    else:
      properties:
        reg:
          maxItems: 2
        reg-names:
          maxItems: 2
        clocks:
          maxItems: 4
        clock-names:
          maxItems: 4
```

## Documentation/devicetree/bindings/misc/realme,op6893-modem-resources.yaml
```yaml
# SPDX-License-Identifier: (GPL-2.0-only OR BSD-2-Clause)
%YAML 1.2
---
$id: http://devicetree.org/schemas/misc/realme,op6893-modem-resources.yaml#
$schema: http://devicetree.org/meta-schemas/core.yaml#

title: Realme op6893 modem framework resource reference check

maintainers:
  - hzyry2046 <hzyry2046@163.com>

description: |
  Board-specific diagnostic node for resolving modem supplies and the four
  ordinary AP/MD and CCIF1 AP/MD clock gates. It does not describe a complete
  modem and has no power-domain, reset, MMIO, IRQ, DMA or SCP interface.
  The checker does not request supply or clock enable and does not prove that
  the modem can start. Provider initialization, deferred regulator constraints,
  supply resolution and shutdown behavior must be reviewed separately before
  enabling the corresponding provider nodes.
  This node is distinct from the LK metadata handoff inspector.

properties:
  compatible:
    const: realme,op6893-modem-resources

  md-vmodem-supply:
    description: VMODEM from MT6315 SID3 VBUCK1

  md-vnr-supply:
    description: VNR from MT6315 SID3 VBUCK3

  md-vsram-supply:
    description: VSRAM_MD from MT6315 SID3 VBUCK4

  md-vdigrf-supply:
    description: VRFDIG from the MT6359P VPU buck

  clocks:
    items:
      - description: CCIF AP gate
      - description: CCIF MD gate
      - description: CCIF1 AP gate
      - description: CCIF1 MD gate

  clock-names:
    items:
      - const: ccif-ap
      - const: ccif-md
      - const: ccif1-ap
      - const: ccif1-md

required:
  - compatible
  - md-vmodem-supply
  - md-vnr-supply
  - md-vsram-supply
  - md-vdigrf-supply
  - clocks
  - clock-names

additionalProperties: false

examples:
  - |
    #include <dt-bindings/clock/mt6893-clk.h>

    modem-resources {
        compatible = "realme,op6893-modem-resources";
        md-vmodem-supply = <&mt6315_3_vbuck1>;
        md-vnr-supply = <&mt6315_3_vbuck3>;
        md-vsram-supply = <&mt6315_3_vbuck4>;
        md-vdigrf-supply = <&mt6359_vpu>;
        clocks = <&infracfg CLK_IFRAO_CCIF_AP>,
                 <&infracfg CLK_IFRAO_CCIF_MD>,
                 <&infracfg CLK_IFRAO_CCIF1_AP>,
                 <&infracfg CLK_IFRAO_CCIF1_MD>;
        clock-names = "ccif-ap", "ccif-md", "ccif1-ap", "ccif1-md";
        status = "disabled";
    };
```

## Documentation/devicetree/bindings/misc/realme,op6893-scp-observe.yaml
```yaml
# SPDX-License-Identifier: (GPL-2.0-only OR BSD-2-Clause)
%YAML 1.2
---
$id: http://devicetree.org/schemas/misc/realme,op6893-scp-observe.yaml#
$schema: http://devicetree.org/meta-schemas/core.yaml#

title: Realme op6893 AP-side SCP prerequisites observer

maintainers:
  - hzyry2046 <hzyry2046@163.com>

description: |
  Temporary board diagnostic for the AP TOPCK SCP mux selector and gate,
  and firmware/share reserved-memory allocation bookkeeping. It does not
  automatically access SCP registers, TCM or firmware contents,
  send mailbox/awake messages, reset SCP or establish processor readiness.
  Additional opt-ins permit explicit read-only core0 reset/status samples and
  exact-length TCM header metadata snapshots and mailbox pending words.
  Pending observation never acknowledges a message or requests an IRQ.
  An independent opt-in holds the constrained 26 MHz SCP output; it does not
  select a new parent or establish an SPM resource vote.
  No raw header or mailbox payload is exported.
  Disabled by default; not a complete SCP hardware description.

properties:
  compatible:
    const: realme,op6893-scp-observe

  clocks:
    maxItems: 1
    description: Constrained SCP bootstrap output from the existing TOPCK provider

  clock-names:
    const: scp

  reg:
    items:
      - description: Same-board SCP core0 configuration, 0x10730000 size 0x1000
      - description: TCM resource, 0x10500000 size 0x180000; only header is mapped
      - description: Mailbox 0 CLR/pending word, 0x107fb10c size 4
      - description: Mailbox 1 CLR/pending word, 0x107fc10c size 4
      - description: Mailbox 2 CLR/pending word, 0x107fd10c size 4
      - description: Mailbox 3 CLR/pending word, 0x107fe10c size 4
      - description: Mailbox 4 CLR/pending word, 0x107ff10c size 4

  reg-names:
    items:
      - const: core0
      - const: tcm
      - const: mbox0-clr
      - const: mbox1-clr
      - const: mbox2-clr
      - const: mbox3-clr
      - const: mbox4-clr

  interrupts:
    maxItems: 5

  interrupt-names:
    items:
      - const: mbox0
      - const: mbox1
      - const: mbox2
      - const: mbox3
      - const: mbox4

  mediatek,send-table:
    $ref: /schemas/types.yaml#/definitions/uint32-array
    minItems: 3
    maxItems: 192
    description: Full TX layout, channel/mailbox/words triples

  mediatek,recv-table:
    $ref: /schemas/types.yaml#/definitions/uint32-array
    minItems: 4
    maxItems: 256
    description: Full RX layout, channel/mailbox/words/response quadruples

  mediatek,topckgen:
    $ref: /schemas/types.yaml#/definitions/phandle
    description: Existing shared AP TOPCK syscon, without SCP reset attachment

  memory-region:
    items:
      - description: Static no-map SCP firmware reservation
      - description: Dynamic no-map SCP shared memory reservation

  memory-region-names:
    items:
      - const: firmware
      - const: share

required:
  - compatible
  - reg
  - reg-names
  - interrupts
  - interrupt-names
  - mediatek,topckgen
  - memory-region
  - memory-region-names

additionalProperties: false

examples:
  - |
    scp-observe@10730000 {
        compatible = "realme,op6893-scp-observe";
        reg = <0x10730000 0x1000>, <0x10500000 0x180000>,
              <0x107fb10c 4>, <0x107fc10c 4>, <0x107fd10c 4>,
              <0x107fe10c 4>, <0x107ff10c 4>;
        reg-names = "core0", "tcm", "mbox0-clr", "mbox1-clr",
                    "mbox2-clr", "mbox3-clr", "mbox4-clr";
        interrupts = <0 436 4>, <0 437 4>, <0 438 4>, <0 439 4>, <0 440 4>;
        interrupt-names = "mbox0", "mbox1", "mbox2", "mbox3", "mbox4";
        mediatek,topckgen = <&topckgen>;
        memory-region = <&scp_firmware_mem>, <&scp_share_mem>;
        memory-region-names = "firmware", "share";
        status = "disabled";
    };
```
