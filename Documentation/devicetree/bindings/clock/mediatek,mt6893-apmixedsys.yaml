## Documentation/devicetree/bindings/misc/realme,op6893-scp-resource-hold.yaml
```yaml
# SPDX-License-Identifier: (GPL-2.0-only OR BSD-2-Clause)
%YAML 1.2
---
$id: http://devicetree.org/schemas/misc/realme,op6893-scp-resource-hold.yaml#
$schema: http://devicetree.org/meta-schemas/core.yaml#

title: Realme op6893 experimental SCP bootstrap resource owner

maintainers:
  - hzyry2046 <hzyry2046@163.com>

description: |
  Temporary board diagnostic for the MT6893 ATF SCP resource channel and
  its low-power resource-manager bookkeeping. Explicit queries report only
  SCP membership. A separately requested 26 MHz pin is additive and lasts
  for the boot. The owner does not release inherited SCP resources, change
  parent clocks or establish READY by default. An
  additional opt-in reserves the complete SCP cfg window in this owner,
  without reading or writing it. No completion operation is exposed.
  An additional IRQ opt-in requests all five dedicated mailbox interrupts
  without enabling them; no receive/arm operation is exposed.
  A further opt-in replaces the cfg mapping with non-posted mappings of
  complete cfg/mailbox pages, excluding the overlapping pending observer.
  It only reserves resources and exposes bookkeeping, without register I/O.
  No SMC is made during probe. Disabled by default; not a complete SCP
  processor or power-domain description.

  Another opt-in reserves complete core0/core1 configuration pages and TCM
  in this owner with non-posted Device mappings. It excludes legacy SCP
  observers and performs no register/TCM I/O or reset/restore operation.

  A separate read-only option observes the two cores and exact TCM header
  under the same owner lock, with explicit pin and before/after clock/mux
  checks. Only bounded metadata and CPU recovery geometry are reported.
  Probe still performs no register/TCM reads or SMC queries.

  An explicit optional reset experiment stops the receive adapter, then
  writes SET on both cores and records active-low reset readbacks. It does
  not release reset, copy firmware or establish message isolation or READY.

properties:
  compatible:
    const: realme,op6893-scp-resource-hold

  reg:
    minItems: 6
    items:
      - description: Complete SCP cfg page at 0x10724000, size 0x1000
      - description: Complete mailbox 0 page at 0x107fb000, size 0x1000
      - description: Complete mailbox 1 page at 0x107fc000, size 0x1000
      - description: Complete mailbox 2 page at 0x107fd000, size 0x1000
      - description: Complete mailbox 3 page at 0x107fe000, size 0x1000
      - description: Complete mailbox 4 page at 0x107ff000, size 0x1000
      - description: Complete core0 configuration page at 0x10730000, size 0x1000
      - description: Complete core1 configuration page at 0x10740000, size 0x1000
      - description: Complete TCM at 0x10500000, size 0x180000

  reg-names:
    minItems: 6
    items:
      - const: scp-cfg
      - const: mbox0
      - const: mbox1
      - const: mbox2
      - const: mbox3
      - const: mbox4
      - const: core0
      - const: core1
      - const: tcm

  interrupts:
    minItems: 5
    maxItems: 5

  interrupt-names:
    items:
      - const: mbox0
      - const: mbox1
      - const: mbox2
      - const: mbox3
      - const: mbox4

  clocks:
    maxItems: 1
    description: Constrained 26 MHz SCP output from the existing TOPCK provider

  clock-names:
    const: scp

  mediatek,topckgen:
    $ref: /schemas/types.yaml#/definitions/phandle
    description: Existing TOPCK syscon for read-only SCP mux checks

  memory-region:
    items:
      - description: This boot's no-map SCP firmware reservation
      - description: This boot's no-map SCP shared-memory reservation

  memory-region-names:
    items:
      - const: firmware
      - const: share

required:
  - compatible
  - reg
  - reg-names
  - interrupts
  - interrupt-names
  - clocks
  - clock-names

dependentRequired:
  mediatek,topckgen: [memory-region, memory-region-names]
  memory-region: ["mediatek,topckgen", memory-region-names]
  memory-region-names: ["mediatek,topckgen", memory-region]

allOf:
  - oneOf:
      - properties:
          reg:
            maxItems: 6
          reg-names:
            maxItems: 6
      - properties:
          reg:
            minItems: 9
          reg-names:
            minItems: 9

additionalProperties: false

examples:
  - |
    #include <dt-bindings/interrupt-controller/arm-gic.h>
    scp-resource-hold@10724000 {
        compatible = "realme,op6893-scp-resource-hold";
        reg = <0x10724000 0x1000>,
              <0x107fb000 0x1000>,
              <0x107fc000 0x1000>,
              <0x107fd000 0x1000>,
              <0x107fe000 0x1000>,
              <0x107ff000 0x1000>,
              <0x10730000 0x1000>,
              <0x10740000 0x1000>,
              <0x10500000 0x180000>;
        reg-names = "scp-cfg", "mbox0", "mbox1", "mbox2", "mbox3", "mbox4",
                    "core0", "core1", "tcm";
        interrupt-parent = <&gic>;
        interrupts = <GIC_SPI 436 IRQ_TYPE_LEVEL_HIGH>,
                     <GIC_SPI 437 IRQ_TYPE_LEVEL_HIGH>,
                     <GIC_SPI 438 IRQ_TYPE_LEVEL_HIGH>,
                     <GIC_SPI 439 IRQ_TYPE_LEVEL_HIGH>,
                     <GIC_SPI 440 IRQ_TYPE_LEVEL_HIGH>;
        interrupt-names = "mbox0", "mbox1", "mbox2", "mbox3", "mbox4";
        clocks = <&topckgen 119>;
        clock-names = "scp";
        status = "disabled";
    };
```

## Documentation/devicetree/bindings/regulator/onnn,fan53870.yaml
```yaml
# SPDX-License-Identifier: (GPL-2.0-only OR BSD-2-Clause)
%YAML 1.2
---
$id: http://devicetree.org/schemas/regulator/onnn,fan53870.yaml#
$schema: http://devicetree.org/meta-schemas/core.yaml#

title: ON Semiconductor FAN53870 PMIC

maintainers:
  - hzyry2046 <hzyry2046@163.com>

description:
  The FAN53870 is an I2C PMIC with seven low dropout regulators.

properties:
  compatible:
    const: onnn,fan53870

  reg:
    maxItems: 1

  vin34-supply:
    description: Input supply for LDO3 and LDO4.

  regulators:
    type: object
    patternProperties:
      "^LDO[1-7]$":
        type: object
        $ref: regulator.yaml#
        unevaluatedProperties: false
    additionalProperties: false

required:
  - compatible
  - reg
  - regulators

additionalProperties: false
```

## arch/arm64/configs/op6893_boot_defconfig
```kconfig
CONFIG_LOCALVERSION="-op6893-direct"
# CONFIG_LOCALVERSION_AUTO is not set
CONFIG_SYSVIPC=y
CONFIG_NO_HZ_IDLE=y
CONFIG_HIGH_RES_TIMERS=y
CONFIG_PREEMPT_NONE=y
CONFIG_IKCONFIG=y
CONFIG_IKCONFIG_PROC=y
CONFIG_LOG_BUF_SHIFT=18
CONFIG_BLK_DEV_INITRD=y
CONFIG_EXPERT=y
# CONFIG_SYSFS_SYSCALL is not set
# CONFIG_AIO is not set
# CONFIG_IO_URING is not set
CONFIG_KALLSYMS=y
CONFIG_ARCH_MEDIATEK=y
CONFIG_ARM64_VA_BITS_48=y
CONFIG_NR_CPUS=8
CONFIG_HOTPLUG_CPU=y
# CONFIG_ARM64_PTR_AUTH is not set
# CONFIG_ARM64_SVE is not set
# CONFIG_ARM64_SME is not set
# CONFIG_RANDOMIZE_BASE is not set
# CONFIG_EFI is not set
CONFIG_ARM64_OP6893_BRINGUP=y
CONFIG_SUSPEND=y
# CONFIG_CPU_IDLE is not set
# CONFIG_CPU_FREQ is not set
CONFIG_SECCOMP=y
CONFIG_SECCOMP_FILTER=y
# CONFIG_STACKPROTECTOR is not set
# CONFIG_GCC_PLUGINS is not set
CONFIG_BLOCK=y
CONFIG_PARTITION_ADVANCED=y
CONFIG_EFI_PARTITION=y
CONFIG_SCSI=y
CONFIG_BLK_DEV_SD=y
CONFIG_SCSI_UFSHCD=y
CONFIG_SCSI_UFSHCD_PLATFORM=y
CONFIG_SCSI_UFS_MEDIATEK=y
CONFIG_PM=y
CONFIG_RESET_CONTROLLER=y
CONFIG_NET=y
CONFIG_INET=y
CONFIG_UNIX=y
CONFIG_PACKET=y
CONFIG_DEVTMPFS=y
CONFIG_DEVTMPFS_MOUNT=y
# CONFIG_FW_LOADER is not set
CONFIG_INPUT=y
CONFIG_INPUT_EVDEV=y
CONFIG_KEYBOARD_GPIO=y
CONFIG_INPUT_TOUCHSCREEN=y
CONFIG_TOUCHSCREEN_EDT_FT5X06=y
CONFIG_INPUT_MISC=y
CONFIG_INPUT_UINPUT=y
# CONFIG_KEYBOARD_ATKBD is not set
# CONFIG_INPUT_MOUSE is not set
# CONFIG_SERIO is not set
# CONFIG_VT is not set
# CONFIG_LEGACY_PTYS is not set
# CONFIG_SERIAL_8250 is not set
# CONFIG_HW_RANDOM is not set
CONFIG_I2C=y
CONFIG_I2C_CHARDEV=y
CONFIG_I2C_MT65XX=y
# CONFIG_SPI is not set
CONFIG_PINCTRL=y
CONFIG_PINCTRL_MT6893=y
CONFIG_GPIO_CDEV=y
CONFIG_DEBUG_FS=y
# CONFIG_HWMON is not set
# CONFIG_THERMAL is not set
CONFIG_MFD_SUPPORT=y
CONFIG_MFD_MT6360=y
# CONFIG_DRM is not set
# CONFIG_SOUND is not set
CONFIG_REGULATOR=y
CONFIG_REGULATOR_FIXED_VOLTAGE=y
CONFIG_REGULATOR_MT6360=y
CONFIG_MEDIATEK_MT6360_ADC=y
CONFIG_POWER_SUPPLY=y
CONFIG_GENERIC_ADC_BATTERY=y
CONFIG_CHARGER_MT6360=y
CONFIG_USB_SUPPORT=y
CONFIG_USB_GADGET=y
CONFIG_USB_MTU3=y
CONFIG_USB_MTU3_GADGET=y
CONFIG_USB_CONFIGFS=y
CONFIG_USB_CONFIGFS_ACM=y
CONFIG_USB_CONFIGFS_ECM=y
CONFIG_PHY_MTK_TPHY=y
# CONFIG_MMC is not set
# CONFIG_VIRTIO_MENU is not set
# CONFIG_VHOST_MENU is not set
# CONFIG_IOMMU_SUPPORT is not set
CONFIG_TMPFS=y
CONFIG_PSTORE=y
CONFIG_PSTORE_CONSOLE=y
CONFIG_PSTORE_PMSG=y
CONFIG_PSTORE_RAM=y
CONFIG_PRINTK_TIME=y
CONFIG_MAGIC_SYSRQ=y
CONFIG_DEBUG_KERNEL=y
CONFIG_WATCHDOG=y
CONFIG_WATCHDOG_HANDLE_BOOT_ENABLED=y
CONFIG_MEDIATEK_WATCHDOG=y
CONFIG_EXT4_FS=y
CONFIG_BLK_DEV_LOOP=y
CONFIG_SQUASHFS=y
CONFIG_SQUASHFS_XZ=y
CONFIG_OVERLAY_FS=y
CONFIG_UNIX98_PTYS=y
CONFIG_TMPFS_XATTR=y

# CONFIG_PINCTRL_MT7620 is not set
# CONFIG_PINCTRL_MT7621 is not set
# CONFIG_PINCTRL_MT76X8 is not set
# CONFIG_PINCTRL_MT2701 is not set
# CONFIG_PINCTRL_MT7623 is not set
# CONFIG_PINCTRL_MT7629 is not set
# CONFIG_PINCTRL_MT8135 is not set
# CONFIG_PINCTRL_MT8127 is not set
# CONFIG_PINCTRL_MT2712 is not set
# CONFIG_PINCTRL_MT6735 is not set
# CONFIG_PINCTRL_MT6765 is not set
# CONFIG_PINCTRL_MT6779 is not set
# CONFIG_PINCTRL_MT6795 is not set
# CONFIG_PINCTRL_MT6797 is not set
# CONFIG_PINCTRL_MT6858 is not set
# CONFIG_PINCTRL_MT6878 is not set
# CONFIG_PINCTRL_MT7622 is not set
# CONFIG_PINCTRL_MT7981 is not set
# CONFIG_PINCTRL_MT7986 is not set
# CONFIG_PINCTRL_MT7988 is not set
# CONFIG_PINCTRL_MT8167 is not set
# CONFIG_PINCTRL_MT8173 is not set
# CONFIG_PINCTRL_MT8183 is not set
# CONFIG_PINCTRL_MT8186 is not set
# CONFIG_PINCTRL_MT8188 is not set
# CONFIG_PINCTRL_MT8189 is not set
# CONFIG_PINCTRL_MT8192 is not set
# CONFIG_PINCTRL_MT8195 is not set
# CONFIG_PINCTRL_MT8196 is not set
# CONFIG_PINCTRL_MT8365 is not set
# CONFIG_PINCTRL_MT8516 is not set
# CONFIG_PINCTRL_MT6397 is not set
CONFIG_MTK_PMIC_WRAP=y
CONFIG_COMMON_CLK_MT6893_PMIF=y
CONFIG_MFD_MT6397=y
CONFIG_KEYBOARD_MTK_PMIC=y
CONFIG_REGULATOR_MT6359=y
# CONFIG_RTC_CLASS is not set
CONFIG_IIO=y
CONFIG_MEDIATEK_MT6359_AUXADC=y

CONFIG_COMMON_CLK_MT6893_MAINPLL=y

CONFIG_ARM64_OP6893_LVTS_IDENTIFY=y
CONFIG_ARM64_OP6893_CONN_PREFLIGHT=y
CONFIG_MTK_COMBO=y
CONFIG_MTK_COMBO_CHIP_CONSYS_6893=y
CONFIG_MTK_CONNSYS_DEDICATED_LOG_PATH=y
CONFIG_RTC_LIB=y
CONFIG_MTK_COMBO_BT=y
CONFIG_MTK_BT_MT66XX=y
CONFIG_MTK_BTIF=y
CONFIG_BT=y
CONFIG_BT_RFCOMM=y
CONFIG_BT_RFCOMM_TTY=y
CONFIG_BT_BNEP=y
CONFIG_BT_BNEP_MC_FILTER=y
CONFIG_BT_BNEP_PROTO_FILTER=y
CONFIG_NVMEM=y
CONFIG_NVMEM_PARTITION=y
CONFIG_FW_LOADER=y
CONFIG_WLAN=y
CONFIG_CFG80211=y
CONFIG_MTK_COMBO_WIFI=y
CONFIG_NETDEVICES=y
CONFIG_MTK_COMBO_WIFI_HIF="axi"
CONFIG_ARM64_OP6893_FBKICK=y
CONFIG_BACKLIGHT_CLASS_DEVICE=y
CONFIG_VT=y
CONFIG_VT_CONSOLE=y
CONFIG_FB=y
CONFIG_FB_SIMPLE=y
CONFIG_FRAMEBUFFER_CONSOLE=y
CONFIG_FRAMEBUFFER_CONSOLE_DETECT_PRIMARY=y
CONFIG_FONT_TER16x32=y
CONFIG_FONTS=y
```

## drivers/misc/mediatek/Kconfig
```kconfig
# SPDX-License-Identifier: GPL-2.0
source "drivers/misc/mediatek/connectivity/Kconfig"
source "drivers/misc/mediatek/ccci/Kconfig"
```
